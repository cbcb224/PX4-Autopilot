## src/drivers/lights/rgbled_gpio/Kconfig
```kconfig
menuconfig DRIVERS_LIGHTS_RGBLED_GPIO
	bool "rgbled_gpio"
	default n
	help
		Drive one active-low RGB LED using board GPIO_nLED_RED/GREEN/BLUE.
```
